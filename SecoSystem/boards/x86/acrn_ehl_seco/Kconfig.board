## SecoSystem/boards/x86/acrn_ehl_seco/Kconfig.board
```kconfig
# Copyright (c) 2020 Intel Corporation
# SPDX-License-Identifier: Apache-2.0

config BOARD_ACRN_EHL_SECO
	bool "ACRN Elkhart Lake Seco"
	depends on SOC_IA32
	select CPU_HAS_FPU
	select X86_64
```

## SecoSystem/boards/x86/acrn_ehl_seco/Kconfig.defconfig
```kconfig
# Copyright (c) 2020 Intel Corporation
# SPDX-License-Identifier: Apache-2.0

if BOARD_ACRN_EHL_SECO

config BOARD
	default "acrn_ehl_seco"

config MP_NUM_CPUS
	default 2

config BOARD_ACRN
	bool "Flag to enable ACRN specific ifdefs. Hack!!!"
	default y

config ACRN_VM
	hex "ACRN VM (0/1). Hack!!!"
	default 0

config LIB_A_PART
	bool "Enable test library integration into a partition"
	default y

endif # BOARD_ACRN_EHL_SECO

#config SHELL_BACKEND_SERIAL_INTERRUPT_DRIVEN
#	depends on SHELL_BACKEND_SERIAL
#	default n

#config HPET_TIMER
#	default n if BOARD_ACRN_EHL_SECO
#	default n

#config APIC_TSC_DEADLINE_TIMER
#	default y if BOARD_ACRN_EHL_SECO
#	default y

#config APIC_TIMER
#	default n if BOARD_ACRN_EHL_SECO
#	default n

# TSC on this board is 1.9 GHz, HPET and APIC are 19.2 MHz
#config SYS_CLOCK_HW_CYCLES_PER_SEC
#	default 1900000000 if APIC_TSC_DEADLINE_TIMER
#	default 1900000000 if APIC_TIMER_TSC
#	default 19200000

#if APIC_TIMER
#config APIC_TIMER_IRQ
#	default 24
#config APIC_TIMER_TSC_M
#	default 3
#config APIC_TIMER_TSC_N
#	default 249
#endif
```

## Zephyr_Project/build/Kconfig/Kconfig.shield.defconfig
```kconfig
osource "/home/user/zephyrproject/ISI_Programme/isiApp/Zephyr_Project/../SecoSystem/boards/shields/*/Kconfig.defconfig"
```
